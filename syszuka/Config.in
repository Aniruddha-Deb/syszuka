## syszuka/Config.in
```kconfig
source "$BR2_EXTERNAL_SYSZUKA_PATH/package/tsc-freq-khz/Config.in"
source "$BR2_EXTERNAL_SYSZUKA_PATH/package/libpfc/Config.in"
```

## syszuka/package/libpfc/Config.in
```kconfig
config BR2_PACKAGE_LIBPFC
	bool "libpfc"
	depends on BR2_LINUX_KERNEL
	help
	  A kernel module that provides a low-latency interface
	  for reading performance counters from userspace.

	  https://github.com/obilaniu/libpfc

comment "libpfc needs a Linux kernel to be built"
	depends on !BR2_LINUX_KERNEL
```
