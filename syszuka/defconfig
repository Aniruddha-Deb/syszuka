## syszuka/defconfig
```kconfig
BR2_x86_64=y
BR2_x86_haswell=y
BR2_TOOLCHAIN_BUILDROOT_CXX=y
BR2_GCC_ENABLE_OPENMP=y
BR2_TARGET_GENERIC_HOSTNAME="syszuka"
BR2_TARGET_GENERIC_ISSUE="Welcome to Syszuka"
BR2_TARGET_GENERIC_ROOT_PASSWD="root"
BR2_SYSTEM_BIN_SH_BASH=y
BR2_ROOTFS_OVERLAY="$(BR2_EXTERNAL_SYSZUKA_PATH)/overlay"
BR2_LINUX_KERNEL=y
BR2_LINUX_KERNEL_USE_CUSTOM_CONFIG=y
BR2_LINUX_KERNEL_CUSTOM_CONFIG_FILE="$(BR2_EXTERNAL_SYSZUKA_PATH)/linux_defconfig"
BR2_LINUX_KERNEL_NEEDS_HOST_OPENSSL=y
BR2_PACKAGE_LINUX_TOOLS_CPUPOWER=y
BR2_PACKAGE_LINUX_TOOLS_PERF=y
BR2_PACKAGE_LINUX_TOOLS_PERF_SCRIPTS=y
BR2_PACKAGE_LINUX_TOOLS_PERF_TUI=y
BR2_PACKAGE_BUSYBOX_SHOW_OTHERS=y
BR2_PACKAGE_DHCPCD=y
BR2_PACKAGE_DROPBEAR=y
BR2_PACKAGE_HTOP=y
BR2_TARGET_ROOTFS_INITRAMFS=y
BR2_TARGET_ROOTFS_TAR_GZIP=y
BR2_PACKAGE_TSC_FREQ_KHZ=y
```

## syszuka/package/tsc-freq-khz/Config.in
```kconfig
config BR2_PACKAGE_TSC_FREQ_KHZ
	bool "tsc-freq-khz"
	depends on BR2_LINUX_KERNEL
	help
	  A kernel module that exposes the TSC frequency in KHz
	  through /proc/tsc_freq_khz. This is useful for timing
	  measurements and benchmarking.

	  https://github.com/trailofbits/tsc_freq_khz

comment "tsc-freq-khz needs a Linux kernel to be built"
	depends on !BR2_LINUX_KERNEL
```
